## conf/layer.conf
```bitbake
# We have a conf and classes directory, add to BBPATH
BBPATH .= ":${LAYERDIR}"

# We have recipes-* directories, add to BBFILES
BBFILES += "${LAYERDIR}/recipes-*/*/*.bb \
	${LAYERDIR}/recipes-*/*/*.bbappend"

BBFILE_COLLECTIONS += "meta-zaozeo-tionpro6"
BBFILE_PATTERN_meta-zaozeo-tionpro6 = "^${LAYERDIR}"
BBFILE_PRIORITY_meta-zaozeo-tionpro6 = "5"

# for ffmpeg
LICENSE_FLAGS_WHITELIST += "commercial"

IMAGE_INSTALL_append = " e2fsprogs-mke2fs i2c-tools alsa-utils alsa-utils-aplay  imx-test strace util-linux mtd-utils minicom setserial ethtool iperf3 tcpdump net-tools can-utils iproute2 evtest fb-test fbida python3  python3-pip v4l-utils ffmpeg"
# CORE_IMAGE_EXTRA_INSTALL
```

## conf/machine/tionpro6.conf
```bitbake
#@TYPE: Machine
#@NAME: Zao Zeo TionPro6
#@SOC: i.MX6SX
#@DESCRIPTION: Machine configuration for Zao Zeo TionPro6
#@MAINTAINER: Zao Zeo <danila@zao-zeo.ru>

MACHINEOVERRIDES =. "mx6:mx6sx:"

include conf/machine/include/imx-base.inc
include conf/machine/include/tune-cortexa9.inc

KERNEL_DEVICETREE = "imx6sx-tionpro6.dtb"
KERNEL_IMAGETYPE = "zImage"

PREFERRED_PROVIDER_u-boot = "u-boot-zaozeo"
PREFERRED_PROVIDER_virtual/kernel ?= "linux-zaozeo"
PREFERRED_VERSION_virtual/kernel ?= "4.9%"
PREFERRED_VERSION_linux-zaozeo ?= "4.9%"

# Use SPI NOR U-Boot by default
#IMAGE_BOOTLOADER ?= ""

# Ensure boot scripts will be available at rootfs time
#do_rootfs[depends] += "u-boot-script-zaozeo:do_deploy"

# Boot scripts to install
#BOOT_SCRIPTS = "6x_bootscript-${MACHINE}:6x_bootscript"

#UBOOT_MACHINE ?= "tionpro6_config"

UBOOT_CONFIG ??= "emmc"
#UBOOT_CONFIG[sd] = "mx6sxsabresd_config,sdcard"
UBOOT_CONFIG[emmc] = "mx6sxtionpro6_config"
#UBOOT_CONFIG[mfgtool] = "mx6sxsabresd_config"

SERIAL_CONSOLE = "115200 ttymxc0"

MACHINE_EXTRA_RRECOMMENDS += "linux-firmware-wl12xx"
#MACHINE_FEATURES += " pci wifi bluetooth"
```
